## base_external/configs/aesd_qemu_defconfig
```kconfig
BR2_aarch64=y
BR2_CCACHE=y
BR2_KERNEL_HEADERS_5_15=y
BR2_LINUX_KERNEL=y
BR2_LINUX_KERNEL_USE_ARCH_DEFAULT_CONFIG=y
BR2_TARGET_ROOTFS_EXT2=y
BR2_TARGET_ROOTFS_EXT2_4=y
# BR2_TARGET_ROOTFS_TAR is not set
BR2_PACKAGE_AESD_ASSIGNMENTS=y
```
